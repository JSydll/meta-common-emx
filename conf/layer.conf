## conf/layer.conf
```bitbake
# We have a conf and classes directory, add to BBPATH
BBPATH .= ":${LAYERDIR}"

# We have recipes-* directories, add to BBFILES
BBFILES += "${LAYERDIR}/recipes-*/*/*.bb \
            ${LAYERDIR}/recipes-*/*/*.bbappend"

BBFILE_COLLECTIONS += "meta-common-configs"
BBFILE_PATTERN_meta-common-configs = "^${LAYERDIR}/"
BBFILE_PRIORITY_meta-common-configs = "30"

LAYERDEPENDS_meta-common-configs = "core networking-layer meta-poky-extensions"
LAYERSERIES_COMPAT_meta-common-configs = "dunfell"
```
